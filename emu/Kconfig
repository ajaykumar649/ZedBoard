## emu/Kconfig
```kconfig
###############################################################################
# Please modify this file if you want to configure your own application.
# You can uncommon and/or change the following Kconfig elements.
###############################################################################


if ROOTFS_COMPONENT_APPS_NAME_EMU
	config APPS_EMU
		bool
		default y
		select ROOTFS_PACKAGES_LIBSTDCPLUSPLUS6
	comment "No additional options for EMU"

# 	config APPS_EMU_OPTION0
#	bool "option0"
#	help
#	  Help text
endif
```
